## my-application/modules/tsp55287/drivers/tsp55287/Kconfig
```kconfig
# create a new option in menuconfig

config TPS55287
  bool "TPS55287 Temperature Sensor"
  default n       # default is disabled
  depends on I2C
  help
    Enable driver for TPS55287 Temperature Sensor
```

## my-application/modules/tsp55287/dts/bindings/sensor/microchip,tps55287.yaml
```yaml
description: tps55287 temperature sensor

compatible: "microchip,tps55287"

include: [sensor-device.yaml, i2c-device.yaml]

properties:
  input-gpios:
    type: phandle-array
    required: true
    description: Input GPIO to be sensed.
```

## my-application/tempctrl/build/Kconfig/boards/Kconfig
```kconfig
# Load Zephyr board Kconfig descriptions.
osource "/Users/langmayr/zephyrproject/zephyr/boards/st/nucleo_h563zi/Kconfig"
```

## my-application/tempctrl/build/Kconfig/boards/Kconfig.defconfig
```kconfig
# Load Zephyr board defconfig descriptions.
osource "/Users/langmayr/zephyrproject/zephyr/boards/st/nucleo_h563zi/Kconfig.defconfig"
```

## nucleo-workspace/some_apps/build/Kconfig/boards/Kconfig.sysbuild
```kconfig
# Load Sysbuild board Kconfig descriptions.
osource "/Users/austinbowman/zephyr_testing/nucleo-workspace/zephyr/boards/st/nucleo_h563zi/Kconfig.sysbuild"
```

## nucleo-workspace/threading_app/build/Kconfig/Kconfig.shield
```kconfig
osource "/Users/austinbowman/zephyr_testing/nucleo-workspace/example-application/boards/shields/*/Kconfig.shield"
```

## nucleo-workspace/threading_app/build/Kconfig/arch/Kconfig
```kconfig
# Load Zephyr Arch Kconfig descriptions.
osource "/Users/austinbowman/zephyr_testing/nucleo-workspace/zephyr/arch/rx/Kconfig"
osource "/Users/austinbowman/zephyr_testing/nucleo-workspace/zephyr/arch/x86/Kconfig"
osource "/Users/austinbowman/zephyr_testing/nucleo-workspace/zephyr/arch/xtensa/Kconfig"
osource "/Users/austinbowman/zephyr_testing/nucleo-workspace/zephyr/arch/sparc/Kconfig"
osource "/Users/austinbowman/zephyr_testing/nucleo-workspace/zephyr/arch/riscv/Kconfig"
osource "/Users/austinbowman/zephyr_testing/nucleo-workspace/zephyr/arch/posix/Kconfig"
osource "/Users/austinbowman/zephyr_testing/nucleo-workspace/zephyr/arch/mips/Kconfig"
osource "/Users/austinbowman/zephyr_testing/nucleo-workspace/zephyr/arch/arm64/Kconfig"
osource "/Users/austinbowman/zephyr_testing/nucleo-workspace/zephyr/arch/arm/Kconfig"
osource "/Users/austinbowman/zephyr_testing/nucleo-workspace/zephyr/arch/arc/Kconfig"
```

## nucleo-workspace/threading_app/build/Kconfig/boards/Kconfig.defconfig
```kconfig
# Load Zephyr board defconfig descriptions.
osource "/Users/austinbowman/zephyr_testing/nucleo-workspace/zephyr/boards/st/nucleo_h563zi/Kconfig.defconfig"
```

## nucleo-workspace/threading_app/build/Kconfig/soc/Kconfig
```kconfig
# Load Zephyr SoC Kconfig descriptions.
osource "/Users/austinbowman/zephyr_testing/nucleo-workspace/zephyr/soc/xlnx/zynqmp/Kconfig"
osource "/Users/austinbowman/zephyr_testing/nucleo-workspace/zephyr/soc/xlnx/zynq7000/Kconfig"
osource "/Users/austinbowman/zephyr_testing/nucleo-workspace/zephyr/soc/xlnx/versalnet/Kconfig"
osource "/Users/austinbowman/zephyr_testing/nucleo-workspace/zephyr/soc/xlnx/versal2/Kconfig"
osource "/Users/austinbowman/zephyr_testing/nucleo-workspace/zephyr/soc/xen/Kconfig"
osource "/Users/austinbowman/zephyr_testing/nucleo-workspace/zephyr/soc/wch/ch32v/Kconfig"
osource "/Users/austinbowman/zephyr_testing/nucleo-workspace/zephyr/soc/ti/simplelink/Kconfig"
osource "/Users/austinbowman/zephyr_testing/nucleo-workspace/zephyr/soc/ti/mspm0/Kconfig"
osource "/Users/austinbowman/zephyr_testing/nucleo-workspace/zephyr/soc/ti/lm3s6965/Kconfig"
osource "/Users/austinbowman/zephyr_testing/nucleo-workspace/zephyr/soc/ti/k3/Kconfig"
osource "/Users/austinbowman/zephyr_testing/nucleo-workspace/zephyr/soc/telink/tlsr/Kconfig"
osource "/Users/austinbowman/zephyr_testing/nucleo-workspace/zephyr/soc/starfive/jh71xx/Kconfig"
osource "/Users/austinbowman/zephyr_testing/nucleo-workspace/zephyr/soc/st/stm32/Kconfig"
osource "/Users/austinbowman/zephyr_testing/nucleo-workspace/zephyr/soc/snps/qemu_arc/Kconfig"
osource "/Users/austinbowman/zephyr_testing/nucleo-workspace/zephyr/soc/snps/nsim/arc_v/Kconfig"
osource "/Users/austinbowman/zephyr_testing/nucleo-workspace/zephyr/soc/snps/nsim/arc_classic/Kconfig"
osource "/Users/austinbowman/zephyr_testing/nucleo-workspace/zephyr/soc/snps/hsdk4xd/Kconfig"
osource "/Users/austinbowman/zephyr_testing/nucleo-workspace/zephyr/soc/snps/hsdk/Kconfig"
osource "/Users/austinbowman/zephyr_testing/nucleo-workspace/zephyr/soc/snps/emsk/Kconfig"
osource "/Users/austinbowman/zephyr_testing/nucleo-workspace/zephyr/soc/snps/emsdp/Kconfig"
osource "/Users/austinbowman/zephyr_testing/nucleo-workspace/zephyr/soc/snps/arc_iot/Kconfig"
osource "/Users/austinbowman/zephyr_testing/nucleo-workspace/zephyr/soc/silabs/Kconfig"
osource "/Users/austinbowman/zephyr_testing/nucleo-workspace/zephyr/soc/sifive/sifive_freedom/Kconfig"
osource "/Users/austinbowman/zephyr_testing/nucleo-workspace/zephyr/soc/sensry/Kconfig"
osource "/Users/austinbowman/zephyr_testing/nucleo-workspace/zephyr/soc/rockchip/Kconfig"
osource "/Users/austinbowman/zephyr_testing/nucleo-workspace/zephyr/soc/renode/riscv_virtual/Kconfig"
osource "/Users/austinbowman/zephyr_testing/nucleo-workspace/zephyr/soc/renode/cortex_r8_virtual/Kconfig"
osource "/Users/austinbowman/zephyr_testing/nucleo-workspace/zephyr/soc/renesas/smartbond/Kconfig"
osource "/Users/austinbowman/zephyr_testing/nucleo-workspace/zephyr/soc/renesas/rz/Kconfig"
osource "/Users/austinbowman/zephyr_testing/nucleo-workspace/zephyr/soc/renesas/rx/Kconfig"
osource "/Users/austinbowman/zephyr_testing/nucleo-workspace/zephyr/soc/renesas/rcar/Kconfig"
osource "/Users/austinbowman/zephyr_testing/nucleo-workspace/zephyr/soc/renesas/ra/Kconfig"
osource "/Users/austinbowman/zephyr_testing/nucleo-workspace/zephyr/soc/realtek/ec/Kconfig"
osource "/Users/austinbowman/zephyr_testing/nucleo-workspace/zephyr/soc/raspberrypi/rpi_pico/Kconfig"
osource "/Users/austinbowman/zephyr_testing/nucleo-workspace/zephyr/soc/quicklogic/eos_s3/Kconfig"
osource "/Users/austinbowman/zephyr_testing/nucleo-workspace/zephyr/soc/qemu/virt_riscv/Kconfig"
osource "/Users/austinbowman/zephyr_testing/nucleo-workspace/zephyr/soc/qemu/malta/Kconfig"
osource "/Users/austinbowman/zephyr_testing/nucleo-workspace/zephyr/soc/openisa/rv32m1/Kconfig"
osource "/Users/austinbowman/zephyr_testing/nucleo-workspace/zephyr/soc/openhwgroup/cva6/Kconfig"
osource "/Users/austinbowman/zephyr_testing/nucleo-workspace/zephyr/soc/oct/osd32mp15x/Kconfig"
osource "/Users/austinbowman/zephyr_testing/nucleo-workspace/zephyr/soc/nxp/s32/Kconfig"
osource "/Users/austinbowman/zephyr_testing/nucleo-workspace/zephyr/soc/nxp/rw/Kconfig"
osource "/Users/austinbowman/zephyr_testing/nucleo-workspace/zephyr/soc/nxp/mcx/Kconfig"
osource "/Users/austinbowman/zephyr_testing/nucleo-workspace/zephyr/soc/nxp/lpc/Kconfig"
osource "/Users/austinbowman/zephyr_testing/nucleo-workspace/zephyr/soc/nxp/layerscape/Kconfig"
osource "/Users/austinbowman/zephyr_testing/nucleo-workspace/zephyr/soc/nxp/kinetis/Kconfig"
osource "/Users/austinbowman/zephyr_testing/nucleo-workspace/zephyr/soc/nxp/imxrt/Kconfig"
osource "/Users/austinbowman/zephyr_testing/nucleo-workspace/zephyr/soc/nxp/imx/Kconfig"
osource "/Users/austinbowman/zephyr_testing/nucleo-workspace/zephyr/soc/nuvoton/numicro/Kconfig"
osource "/Users/austinbowman/zephyr_testing/nucleo-workspace/zephyr/soc/nuvoton/numaker/Kconfig"
osource "/Users/austinbowman/zephyr_testing/nucleo-workspace/zephyr/soc/nuvoton/npcx/Kconfig"
osource "/Users/austinbowman/zephyr_testing/nucleo-workspace/zephyr/soc/nuvoton/npcm/Kconfig"
osource "/Users/austinbowman/zephyr_testing/nucleo-workspace/zephyr/soc/nordic/Kconfig"
osource "/Users/austinbowman/zephyr_testing/nucleo-workspace/zephyr/soc/neorv32/Kconfig"
osource "/Users/austinbowman/zephyr_testing/nucleo-workspace/zephyr/soc/native/inf_clock/Kconfig"
osource "/Users/austinbowman/zephyr_testing/nucleo-workspace/zephyr/soc/microchip/sam/Kconfig"
osource "/Users/austinbowman/zephyr_testing/nucleo-workspace/zephyr/soc/microchip/sam/sam_d5x_e5x/Kconfig"
osource "/Users/austinbowman/zephyr_testing/nucleo-workspace/zephyr/soc/microchip/miv/Kconfig"
osource "/Users/austinbowman/zephyr_testing/nucleo-workspace/zephyr/soc/microchip/mec/Kconfig"
osource "/Users/austinbowman/zephyr_testing/nucleo-workspace/zephyr/soc/mediatek/mt8xxx/Kconfig"
osource "/Users/austinbowman/zephyr_testing/nucleo-workspace/zephyr/soc/lowrisc/opentitan/Kconfig"
osource "/Users/austinbowman/zephyr_testing/nucleo-workspace/zephyr/soc/litex/litex_vexriscv/Kconfig"
osource "/Users/austinbowman/zephyr_testing/nucleo-workspace/zephyr/soc/ite/ec/Kconfig"
osource "/Users/austinbowman/zephyr_testing/nucleo-workspace/zephyr/soc/intel/raptor_lake/Kconfig"
osource "/Users/austinbowman/zephyr_testing/nucleo-workspace/zephyr/soc/intel/lakemont/Kconfig"
osource "/Users/austinbowman/zephyr_testing/nucleo-workspace/zephyr/soc/intel/intel_socfpga_std/Kconfig"
osource "/Users/austinbowman/zephyr_testing/nucleo-workspace/zephyr/soc/intel/intel_socfpga/Kconfig"
osource "/Users/austinbowman/zephyr_testing/nucleo-workspace/zephyr/soc/intel/intel_niosv/Kconfig"
osource "/Users/austinbowman/zephyr_testing/nucleo-workspace/zephyr/soc/intel/intel_ish/Kconfig"
osource "/Users/austinbowman/zephyr_testing/nucleo-workspace/zephyr/soc/intel/intel_adsp/Kconfig"
osource "/Users/austinbowman/zephyr_testing/nucleo-workspace/zephyr/soc/intel/elkhart_lake/Kconfig"
osource "/Users/austinbowman/zephyr_testing/nucleo-workspace/zephyr/soc/intel/atom/Kconfig"
osource "/Users/austinbowman/zephyr_testing/nucleo-workspace/zephyr/soc/intel/apollo_lake/Kconfig"
osource "/Users/austinbowman/zephyr_testing/nucleo-workspace/zephyr/soc/intel/alder_lake/Kconfig"
osource "/Users/austinbowman/zephyr_testing/nucleo-workspace/zephyr/soc/infineon/cat3/Kconfig"
osource "/Users/austinbowman/zephyr_testing/nucleo-workspace/zephyr/soc/infineon/cat1c/Kconfig"
osource "/Users/austinbowman/zephyr_testing/nucleo-workspace/zephyr/soc/infineon/cat1b/Kconfig"
osource "/Users/austinbowman/zephyr_testing/nucleo-workspace/zephyr/soc/infineon/cat1a/Kconfig"
osource "/Users/austinbowman/zephyr_testing/nucleo-workspace/zephyr/soc/gd/gd32/Kconfig"
osource "/Users/austinbowman/zephyr_testing/nucleo-workspace/zephyr/soc/gaisler/leon3/Kconfig"
osource "/Users/austinbowman/zephyr_testing/nucleo-workspace/zephyr/soc/gaisler/gr716a/Kconfig"
osource "/Users/austinbowman/zephyr_testing/nucleo-workspace/zephyr/soc/espressif/Kconfig"
osource "/Users/austinbowman/zephyr_testing/nucleo-workspace/zephyr/soc/ene/kb1200/Kconfig"
osource "/Users/austinbowman/zephyr_testing/nucleo-workspace/zephyr/soc/ene/kb106x/Kconfig"
osource "/Users/austinbowman/zephyr_testing/nucleo-workspace/zephyr/soc/efinix/sapphire/Kconfig"
osource "/Users/austinbowman/zephyr_testing/nucleo-workspace/zephyr/soc/cdns/xtensa_sample_controller/Kconfig"
osource "/Users/austinbowman/zephyr_testing/nucleo-workspace/zephyr/soc/cdns/sample_controller32/Kconfig"
osource "/Users/austinbowman/zephyr_testing/nucleo-workspace/zephyr/soc/cdns/dc233c/Kconfig"
osource "/Users/austinbowman/zephyr_testing/nucleo-workspace/zephyr/soc/brcm/bcmvk/Kconfig"
osource "/Users/austinbowman/zephyr_testing/nucleo-workspace/zephyr/soc/brcm/bcm2712/Kconfig"
osource "/Users/austinbowman/zephyr_testing/nucleo-workspace/zephyr/soc/brcm/bcm2711/Kconfig"
osource "/Users/austinbowman/zephyr_testing/nucleo-workspace/zephyr/soc/bflb/Kconfig"
osource "/Users/austinbowman/zephyr_testing/nucleo-workspace/zephyr/soc/atmel/sam0/Kconfig"
osource "/Users/austinbowman/zephyr_testing/nucleo-workspace/zephyr/soc/atmel/sam/Kconfig"
osource "/Users/austinbowman/zephyr_testing/nucleo-workspace/zephyr/soc/aspeed/Kconfig"
osource "/Users/austinbowman/zephyr_testing/nucleo-workspace/zephyr/soc/arm/Kconfig"
osource "/Users/austinbowman/zephyr_testing/nucleo-workspace/zephyr/soc/arm/beetle/Kconfig"
osource "/Users/austinbowman/zephyr_testing/nucleo-workspace/zephyr/soc/antmicro/myra/Kconfig"
osource "/Users/austinbowman/zephyr_testing/nucleo-workspace/zephyr/soc/andestech/Kconfig"
osource "/Users/austinbowman/zephyr_testing/nucleo-workspace/zephyr/soc/amd/acp_6_0/Kconfig"
osource "/Users/austinbowman/zephyr_testing/nucleo-workspace/zephyr/soc/ambiq/Kconfig"
osource "/Users/austinbowman/zephyr_testing/nucleo-workspace/zephyr/soc/aesc/Kconfig"
osource "/Users/austinbowman/zephyr_testing/nucleo-workspace/zephyr/soc/adi/max32/Kconfig"
```

## tempctrl/build/Kconfig/Kconfig.modules
```kconfig
menu "example-application (/Users/austinbowman/my-workspace/example-application)"
osource "/Users/austinbowman/my-workspace/example-application/Kconfig"
config ZEPHYR_EXAMPLE_APPLICATION_MODULE
	bool
	default y
endmenu
menu "cmsis_6 (/Users/austinbowman/my-workspace/modules/hal/cmsis_6)"
osource "$(ZEPHYR_CMSIS_6_KCONFIG)"
config ZEPHYR_CMSIS_6_MODULE
	bool
	default y
endmenu
menu "hal_nordic (/Users/austinbowman/my-workspace/modules/hal/nordic)"
osource "$(ZEPHYR_HAL_NORDIC_KCONFIG)"
config ZEPHYR_HAL_NORDIC_MODULE
	bool
	default y

config ZEPHYR_HAL_NORDIC_MODULE_BLOBS
	bool
endmenu
config ZEPHYR_HAL_STM32_MODULE
	bool
	default y

config ZEPHYR_HAL_STM32_MODULE_BLOBS
	bool
```

## tempctrl/build/Kconfig/Kconfig.shield.defconfig
```kconfig
osource "/Users/austinbowman/my-workspace/example-application/tempctrl/boards/shields/*/Kconfig.defconfig"
```

## tempctrl/build/Kconfig/arch/Kconfig
```kconfig
# Load Zephyr Arch Kconfig descriptions.
osource "/Users/austinbowman/my-workspace/zephyr/arch/rx/Kconfig"
osource "/Users/austinbowman/my-workspace/zephyr/arch/x86/Kconfig"
osource "/Users/austinbowman/my-workspace/zephyr/arch/xtensa/Kconfig"
osource "/Users/austinbowman/my-workspace/zephyr/arch/sparc/Kconfig"
osource "/Users/austinbowman/my-workspace/zephyr/arch/riscv/Kconfig"
osource "/Users/austinbowman/my-workspace/zephyr/arch/posix/Kconfig"
osource "/Users/austinbowman/my-workspace/zephyr/arch/mips/Kconfig"
osource "/Users/austinbowman/my-workspace/zephyr/arch/arm64/Kconfig"
osource "/Users/austinbowman/my-workspace/zephyr/arch/arm/Kconfig"
osource "/Users/austinbowman/my-workspace/zephyr/arch/arc/Kconfig"
```

## tempctrl/build/Kconfig/boards/Kconfig
```kconfig
# Load Zephyr board Kconfig descriptions.
osource "/Users/austinbowman/my-workspace/zephyr/boards/st/nucleo_h563zi/Kconfig"
```

## tempctrl/build/Kconfig/boards/Kconfig.defconfig
```kconfig
# Load Zephyr board defconfig descriptions.
osource "/Users/austinbowman/my-workspace/zephyr/boards/st/nucleo_h563zi/Kconfig.defconfig"
```

## tempctrl/build/Kconfig/boards/Kconfig.nucleo_h563zi
```kconfig
# Load board Kconfig descriptions.
osource "/Users/austinbowman/my-workspace/zephyr/boards/st/nucleo_h563zi/Kconfig.nucleo_h563zi"
```

## tempctrl/build/Kconfig/boards/Kconfig.sysbuild
```kconfig
# Load Sysbuild board Kconfig descriptions.
osource "/Users/langmayr/zephyrproject/zephyr/boards/st/nucleo_h563zi/Kconfig.sysbuild"
```
